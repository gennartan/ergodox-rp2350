&flash0 {
    erase-block-size = <4096>;
    partitions {
        keyboard_config_partition: partition@100000 {
            compatible = "zephyr,mapped-partition";
            label = "keyboard-config";
            reg = <0x100000 0x4000>;
        };
    };
};
